## sdkconfig.defaults
```kconfig
# ----Base_Parametr ----
CONFIG_IDF_TARGET="esp32c6"
CONFIG_ESP_MAIN_TASK_STACK_SIZE=8192

# ---- Wi-Fi AP for Web UI ----
CONFIG_ESP_WIFI_ENABLED=y
CONFIG_ESP_WIFI_SOFTAP_SUPPORT=y
CONFIG_ESP_WIFI_SOFTAP_SSID="rfid-c6"
CONFIG_ESP_WIFI_SOFTAP_PASSWORD="12345678"
CONFIG_ESP_WIFI_SOFTAP_CHANNEL=6
CONFIG_ESP_WIFI_SOFTAP_SSID_HIDDEN=n
CONFIG_ESP_WIFI_SOFTAP_MAX_STA_CONN=4

# ---- HTTP  ----
CONFIG_HTTPD_MAX_REQ_HDR_LEN=1024
CONFIG_HTTPD_MAX_URI_LEN=256

# ---- Logs ----
CONFIG_LOG_DEFAULT_LEVEL_INFO=y

# ---- Zigbee 
CONFIG_ZIGBEE_ROLE_ROUTER=y
```
